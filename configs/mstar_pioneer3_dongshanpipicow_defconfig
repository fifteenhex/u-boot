## configs/mstar_pioneer3_dongshanpipicow_defconfig
```kconfig
CONFIG_ARM=y
# CONFIG_SPL_USE_ARCH_MEMCPY is not set
# CONFIG_SPL_USE_ARCH_MEMSET is not set
CONFIG_ARCH_MSTARV7=y
CONFIG_MSTAR_BANG_BOOT0=y
CONFIG_MSTAR_PIONEER3=y
CONFIG_TARGET_DONGSHANPIPICOW=y
CONFIG_MTDPARTS_DEFAULT="spi-nand0:-@384K(ubi)"
CONFIG_DEBUG_UART=y
# CONFIG_SPL_RAW_IMAGE_SUPPORT is not set
CONFIG_SPL_SPI_NAND_SUPPORT_WINBOND=y
# CONFIG_SPL_BLK is not set
CONFIG_DEBUG_UART_ANNOUNCE=y
CONFIG_DEBUG_UART_SKIP_INIT=y
```

## configs/mstarv7_defconfig
```kconfig
CONFIG_ARM=y
CONFIG_ARCH_MSTARV7=y
CONFIG_MSTAR_IPL=y
CONFIG_TARGET_MSTARV7=y
CONFIG_DEFAULT_DEVICE_TREE="mstar-infinity2m-ssd201"
CONFIG_OF_LIST="mstar-infinity2m-ssd201 mstar-infinity2m-ssd202d"

#CONFIG_DEBUG_LL=y
#CONFIG_DEBUG_LL_UART_8250=y
#CONFIG_DEBUG_UART_PHYS=0x1f221000
#CONFIG_DEBUG_UART_8250_SHIFT=3

#CONFIG_DEBUG_UART=y
#CONFIG_DEBUG_UART_SKIP_INIT=y

CONFIG_SPL_TEXT_BASE=0xa0000000

CONFIG_MSTAR_INFINITY2M=y

CONFIG_CMD_MTD=y
```

## configs/mvme147_defconfig
```kconfig
CONFIG_M68K=y
CONFIG_TEXT_BASE=0x0
CONFIG_SPL_LIBCOMMON_SUPPORT=y
CONFIG_SPL_LIBGENERIC_SUPPORT=y
CONFIG_NR_DRAM_BANKS=1
CONFIG_ENV_SIZE=0x800
CONFIG_DEFAULT_DEVICE_TREE="mvme147"
CONFIG_SPL_TEXT_BASE=0x400000
CONFIG_SPL_SERIAL=y
CONFIG_BOOTSTAGE_STASH_ADDR=0
CONFIG_DEBUG_UART_CLOCK=0
CONFIG_SYS_LOAD_ADDR=0x400
CONFIG_ENV_ADDR=0xfffe0800
CONFIG_TARGET_MVME147=y
# CONFIG_MCFTMR is not set
CONFIG_DEBUG_UART=y
CONFIG_LTO=y
# CONFIG_BOOTSTD is not set
# CONFIG_LEGACY_IMAGE_FORMAT is not set
CONFIG_LOG=y
CONFIG_SPL_LOG=y
CONFIG_CYCLIC_MAX_CPU_TIME_US=1000000
CONFIG_BOARD_EARLY_INIT_R=y
CONFIG_STACKPROTECTOR=y
CONFIG_SPL_MAX_SIZE=0x100000
CONFIG_SPL_PAD_TO=0x0
CONFIG_SPL_BSS_MAX_SIZE=0x8000
CONFIG_SPL_YMODEM_SUPPORT=y
CONFIG_SYS_PROMPT="mvme147 =>"
# CONFIG_BOOTM_NETBSD is not set
# CONFIG_BOOTM_PLAN9 is not set
# CONFIG_BOOTM_RTEMS is not set
# CONFIG_BOOTM_VXWORKS is not set
# CONFIG_CMD_ELF_BOOTVX is not set
CONFIG_CMD_UNLZ4=y
CONFIG_CMD_DM=y
CONFIG_CMD_DHCP=y
CONFIG_CMD_WGET=y
CONFIG_CMD_PING=y
CONFIG_CMD_CACHE=y
CONFIG_CMD_GETTIME=y
CONFIG_CMD_FAT=y
# CONFIG_SPL_DOS_PARTITION is not set
CONFIG_EFI_PARTITION=y
# CONFIG_SPL_EFI_PARTITION is not set
CONFIG_SPL_OF_CONTROL=y
CONFIG_OF_EMBED=y
CONFIG_ENV_IS_IN_NVRAM=y
CONFIG_NET_RANDOM_ETHADDR=y
CONFIG_SPL_DM=y
CONFIG_DM_WARN=y
CONFIG_SPL_DM_SEQ_ALIAS=y
CONFIG_REGMAP=y
CONFIG_SPL_REGMAP=y
CONFIG_SYSCON=y
CONFIG_SPL_SYSCON=y
CONFIG_SPL_OF_TRANSLATE=y
CONFIG_SCSI_AHCI=y
# CONFIG_GPIO is not set
# CONFIG_I2C is not set
# CONFIG_INPUT is not set
CONFIG_MISC=y
CONFIG_QEMU_VIRT_CTRL=y
CONFIG_MTD=y
# CONFIG_POWER is not set
CONFIG_SCSI=y
CONFIG_BAUDRATE=9600
CONFIG_SPECIFY_CONSOLE_INDEX=y
CONFIG_SERIAL_SEARCH_ALL=y
CONFIG_DEBUG_SCC_SERIAL=y
CONFIG_DEBUG_UART_ANNOUNCE=y
CONFIG_SCC_SERIAL=y
CONFIG_SPL_TIMER=y
CONFIG_PCC_TIMER=y
CONFIG_WATCHDOG_TIMEOUT_MSECS=25000
CONFIG_WDT=y
# CONFIG_SPL_USE_TINY_PRINTF is not set
CONFIG_CMD_DHRYSTONE=y
CONFIG_SPL_CRC32=y
# CONFIG_GZIP is not set
CONFIG_OF_LIBFDT_ASSUME_MASK=0
CONFIG_LMB_MAX_REGIONS=8
# CONFIG_TOOLS_LIBCRYPTO is not set
# CONFIG_TOOLS_KWBIMAGE is not set
```

## configs/oldmac_defconfig
```kconfig
CONFIG_M68K=y
CONFIG_TEXT_BASE=0x00000000
CONFIG_SYS_MALLOC_LEN=0x20000
CONFIG_SYS_MALLOC_F_LEN=0x2000
CONFIG_SYS_MONITOR_LEN=262144
CONFIG_SYS_BOOTM_LEN=0x1000000
CONFIG_SYS_LOAD_ADDR=0x00000000
CONFIG_TARGET_OLDMAC=y
CONFIG_BUILD_TARGET="oldmac.iso"
CONFIG_BOARD_EARLY_INIT_F=y
CONFIG_DEBUG_UART=y
CONFIG_DEBUG_UART_SCC=y
CONFIG_DEBUG_UART_BASE=0x5000c022
CONFIG_DEBUG_UART_CLOCK=3686400
CONFIG_DISPLAY_BOARDINFO=y
CONFIG_CMD_SCSI=y
CONFIG_CMD_NUBUS=y
CONFIG_SCSI=y
CONFIG_SCSI_ESP=y
CONFIG_DM_SERIAL=y
CONFIG_SCC_SERIAL=y
CONFIG_VIDEO=y
CONFIG_VIDEO_BPP8=y
CONFIG_VIDEO_BPP16=y
CONFIG_VIDEO_BPP32=y
CONFIG_CONSOLE_MUX=y
CONFIG_SYS_CONSOLE_IS_IN_ENV=y
CONFIG_INPUT=y
CONFIG_DM_KEYBOARD=y
CONFIG_CMD_ADB=y
```

## configs/oldmac_spl_defconfig
```kconfig
CONFIG_M68K=y
CONFIG_TEXT_BASE=0x00000000
CONFIG_SYS_MALLOC_LEN=0x20000
CONFIG_SYS_MALLOC_F_LEN=0x2000
CONFIG_SYS_MONITOR_LEN=262144
CONFIG_SYS_BOOTM_LEN=0x1000000
CONFIG_SYS_LOAD_ADDR=0x00000000
CONFIG_TARGET_OLDMAC=y
CONFIG_BUILD_TARGET="oldmac-spl.iso"
CONFIG_BOARD_EARLY_INIT_F=y
CONFIG_DEBUG_UART=y
CONFIG_DEBUG_UART_SCC=y
CONFIG_DEBUG_UART_BASE=0x5000c022
CONFIG_DEBUG_UART_CLOCK=3686400
CONFIG_DISPLAY_BOARDINFO=y
CONFIG_CMD_SCSI=y
CONFIG_SCSI=y
CONFIG_SCSI_ESP=y
CONFIG_DM_SERIAL=y
CONFIG_SCC_SERIAL=y
CONFIG_SPL=y
CONFIG_SPL_TEXT_BASE=0x00100000
CONFIG_SPL_LDSCRIPT="arch/m68k/cpu/m680x0/u-boot-spl.lds"
CONFIG_SPL_SERIAL=y
CONFIG_SPL_LIBCOMMON_SUPPORT=y
CONFIG_SPL_LIBGENERIC_SUPPORT=y
CONFIG_SPL_FRAMEWORK=y
CONFIG_SPL_BSS_MAX_SIZE=0x00008000
CONFIG_SPL_MAX_SIZE=0x00040000
CONFIG_SPL_SYS_MALLOC_F_LEN=0x2000
CONFIG_SPL_DM=y
CONFIG_SPL_DM_SERIAL=y
CONFIG_SPL_SYS_MALLOC=y
CONFIG_SPL_SYS_MALLOC_SIZE=0x00040000
CONFIG_SPL_SCSI=y
CONFIG_SPL_BLK=y
CONFIG_SPL_RAW_IMAGE_SUPPORT=y
CONFIG_SPL_SCSI_RAW_U_BOOT_SECTOR=0x800
CONFIG_SYS_UBOOT_START=0x00000400
```

## configs/qemu_virt_m68k_mc68000_defconfig
```kconfig
CONFIG_M68K=y
CONFIG_TEXT_BASE=0x0
CONFIG_NR_DRAM_BANKS=1
CONFIG_DEFAULT_DEVICE_TREE="virt-m68k"
CONFIG_BOOTSTAGE_STASH_ADDR=0
CONFIG_DEBUG_UART_CLOCK=0
CONFIG_SYS_LOAD_ADDR=0x400
CONFIG_TARGET_QEMU=y
# CONFIG_MCFTMR is not set
CONFIG_DEBUG_UART=y
CONFIG_LTO=y
CONFIG_REMAKE_ELF=y
# CONFIG_BOOTSTD is not set
# CONFIG_LEGACY_IMAGE_FORMAT is not set
CONFIG_STACKPROTECTOR=y
# CONFIG_BOOTM_NETBSD is not set
# CONFIG_BOOTM_PLAN9 is not set
# CONFIG_BOOTM_RTEMS is not set
# CONFIG_BOOTM_VXWORKS is not set
# CONFIG_CMD_ELF_BOOTVX is not set
# CONFIG_CMD_LOADB is not set
# CONFIG_CMD_LOADS is not set
CONFIG_CMD_FAT=y
CONFIG_EFI_PARTITION=y
CONFIG_OF_EMBED=y
CONFIG_DM_WARN=y
# CONFIG_BLOCK_CACHE is not set
# CONFIG_GPIO is not set
# CONFIG_I2C is not set
# CONFIG_INPUT is not set
# CONFIG_POWER is not set
CONFIG_SPECIFY_CONSOLE_INDEX=y
CONFIG_VIRTIO_NET=y
# CONFIG_GZIP is not set
CONFIG_OF_LIBFDT_ASSUME_MASK=0
CONFIG_LMB_MAX_REGIONS=8
```

## drivers/pinctrl/mstar/Kconfig
```kconfig
config PINCTRL_MSTAR
	bool "MStar/SigmaStar pinctrl driver"
	depends on ARCH_MSTARV7 && PINCTRL_FULL
	select DEVRES
```

## drivers/scsi/Kconfig
```kconfig
config SCSI
	bool "Support SCSI controllers with driver model"
	select BLK
	help
	  This enables support for SCSI (Small Computer System Interface),
	  a parallel interface widely used with storage peripherals such as
	  hard drives and optical drives. The SCSI standards define physical
	  interfaces as well as protocols for controlling devices and
	  tranferring data. For every device configuration (IDs/LUNs) a block
	  device is created with RAW read/write and filesystem support.

config SCSI_ESP
	bool "AMD/NCR 53C9x ESP SCSI support"
	depends on SCSI
	select LIBATA
	help
	  This enables support for the AMD/NCR 53C9x "ESP" parallel SCSI
	  controller using pseudo-DMA, as found on classic 68k Macintosh
	  machines such as the Quadra 800 (and QEMU's q800 machine).
```
