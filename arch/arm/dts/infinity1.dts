// SPDX-License-Identifier: GPL-2.0
/*
 * Copyright (c) 2019 thingy.jp.
 * Author: Daniel Palmer <daniel@0x0f.com>
 */

/dts-v1/;

#include "infinity.dtsi"

/ {
        compatible = "mstar,infinity1", "mstar,chenxing-v7";
};
