// SPDX-License-Identifier: GPL-2.0
/*
 * Copyright (c) 2019 thingy.jp.
 * Author: Daniel Palmer <daniel@0x0f.com>
 */

/dts-v1/;

#include "infinity3.dtsi"

/ {
        compatible = "mstar,infinity3-msc313e", "mstar,infinity3", "mstar,mstar-v7";
};
