// SPDX-License-Identifier: GPL-2.0
/*
 * Copyright (c) 2020 thingy.jp.
 * Author: Daniel Palmer <daniel@0x0f.com>
 */

/dts-v1/;

#include "mstar-infinity2m-ssd201.dtsi"

/ {
        compatible = "mstar,infinity2m-ssd201", "mstar,infinity2m-ssd20xd",
		     "mstar,infinity2m", "mstar,mstar-v7";
};

&phy {
	compatible = "ethernet-phy-idDEAD.B33F";
};

&spi_flash {
	compatible = "spi-nand";
	status = "okay";
};
