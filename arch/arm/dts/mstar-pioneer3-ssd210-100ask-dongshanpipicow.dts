// SPDX-License-Identifier: GPL-2.0-or-later
/*
 * Copyright (c) 2022 thingy.jp.
 * Author: Daniel Palmer <daniel@thingy.jp>
 */

/dts-v1/;
#include "mstar-pioneer3-ssd210.dtsi"

/ {
	model = "DongShan Pi PicoW";
	compatible = "sstar-pioneer3-ssd210",
				 "mstar,mstar-v7";

	aliases {
		serial0 = &pm_uart;
	};

	chosen {
		stdout-path = "serial0:115200n8";
		bootargs = "console=ttyS0,115200 clk_ignore_unused earlyprintk";
	};
};

&spi_flash {
	compatible = "spi-nand";
	status = "okay";
};
