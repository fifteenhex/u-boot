// SPDX-License-Identifier: GPL-2.0
/*
 * Copyright (c) 2022 thingy.jp.
 * Author: Daniel Palmer <daniel@0x0f.com>
 */

/dts-v1/;

#include "mstar-v7.dtsi"

/ {
	compatible = "sstar,pioneer3", "mstar,chenxing-v7";
};
