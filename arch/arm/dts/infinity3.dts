// SPDX-License-Identifier: GPL-2.0
/*
 * Copyright (c) 2019 thingy.jp.
 * Author: Daniel Palmer <daniel@0x0f.com>
 */

/dts-v1/;

#include "infinity.dtsi"

/ {
        compatible = "mstar,infinity3", "mstar,chenxing-v7";
};

&phy {
	compatible = "ethernet-phy-idDEAD.B33F";
};
