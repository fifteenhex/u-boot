// SPDX-License-Identifier: GPL-2.0
/*
 * Copyright (c) 2020 Daniel Palmer <daniel@thingy.jp>
 */

/dts-v1/;

#include "mstar-v7.dtsi"

/ {
	compatible = "mstar,mstar-v7";

	memory@20000000 {
		device_type = "memory";
		reg = <0x20000000 0x4000000>;
	};
};
