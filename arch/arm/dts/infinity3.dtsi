// SPDX-License-Identifier: GPL-2.0
/*
 * Copyright (c) 2019 thingy.jp.
 * Author: Daniel Palmer <daniel@0x0f.com>
 */

/dts-v1/;

#include "infinity.dtsi"

/ {
        compatible = "mstar,infinity3", "mstar,chenxing-v7";
};

&phy {
	compatible = "ethernet-phy-idDEAD.B33F";
};

&pinctrl {
	compatible = "mstar,msc313e-pinctrl";
};

&emac {
	compatible = "mstar,msc313e-emac";
	reg = <0x2a2000 0x4000>,
	      <0x343c00 0x4000>;
};
