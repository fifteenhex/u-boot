## board/olimex/am335x_som/Kconfig
```kconfig
if TARGET_AM335X_OLIMEX_SOM

config SYS_BOARD
	default "am335x_som"

config SYS_VENDOR
	default "olimex"

config SYS_SOC
	default "am33xx"

config SYS_CONFIG_NAME
	default "olimex_am335x_som"

endif
```

## board/qemu/virt-m68k/Kconfig
```kconfig
if TARGET_QEMU

config SYS_CPU
	default "mc68000"

config SYS_BOARD
	default "virt-m68k"

config SYS_VENDOR
	default "qemu"

config SYS_CONFIG_NAME
	default "virt-m68k"

config DEBUG_UART_BASE
	default 0xff008000

endif
```

## board/sega/megadrive/Kconfig
```kconfig
if TARGET_MEGADRIVE

config SYS_CPU
	default "mc68000"

config SYS_BOARD
	default "megadrive"

config SYS_VENDOR
	default "sega"

config SYS_CONFIG_NAME
	default "megadrive"

config DEBUG_UART_BASE
	default 0xa130d0

endif
```

## board/thingyjp/breadbee/Kconfig
```kconfig
if TARGET_BREADBEE

config SYS_BOARD
	default "breadbee"

config SYS_VENDOR
	default "thingyjp"

config SYS_CONFIG_NAME
	default "breadbee"

config BOARD_SPECIFIC_OPTIONS # dummy
	def_bool y

config OF_LIST
	default "mstar-v7 mstar-infinity-msc313 mstar-infinity3-msc313e"

config DEFAULT_DEVICE_TREE
	default "mstar-v7"

endif
```

## board/wirelesstag/som2d01/Kconfig
```kconfig
if TARGET_SOM2D01

config SYS_BOARD
	default "som2d01"

config SYS_VENDOR
	default "wirelesstag"

config SYS_CONFIG_NAME
        default "som2d01"

config OF_LIST
	default "mstar-infinity2m-ssd201 mstar-infinity2m-ssd202d mstar-infinity2m-ssd201-wirelesstag-ido-som2d01 mstar-infinity2m-ssd202d-wirelesstag-ido-som2d01 mstar-infinity2m-ssd202d-wirelesstag-ido-sbc2d06-v1b-22w"

config DEFAULT_DEVICE_TREE
	default "mstar-infinity2m-ssd201"

config MTDPARTS_DEFAULT
	default "spi-nand0:128256K@2816K(UBI)"

config SPL_UBI
	default y
config SPL_UBI_MAX_VOL_LEBS
	default 256
config SPL_UBI_MAX_PEB_SIZE
	default 131072
config SPL_UBI_MAX_PEBS
	default 1024
config SPL_UBI_VOL_IDS
	default 8
config SPL_UBI_PEB_OFFSET
	default 22
config SPL_UBI_VID_OFFSET
	default 2048
config SPL_UBI_LEB_START
	default 4096
config SPL_UBI_LOAD_MONITOR_ID
	default 0

endif
```

## configs/am335x_olimex_som_defconfig
```kconfig
CONFIG_ARM=y
CONFIG_ARCH_CPU_INIT=y
CONFIG_ARCH_OMAP2PLUS=y
CONFIG_SPL_GPIO_SUPPORT=y
CONFIG_SPL_LIBCOMMON_SUPPORT=y
CONFIG_SPL_LIBGENERIC_SUPPORT=y
CONFIG_AM33XX=y
CONFIG_TARGET_AM335X_OLIMEX_SOM=y
CONFIG_SPL_MMC_SUPPORT=y
CONFIG_SPL_SERIAL_SUPPORT=y
CONFIG_SPL=y
CONFIG_DEBUG_UART_BASE=0x44e09000
CONFIG_DEBUG_UART_CLOCK=48000000
CONFIG_DEFAULT_DEVICE_TREE="am335x-olimex-som"
CONFIG_DEBUG_UART=y
CONFIG_ENV_VARS_UBOOT_CONFIG=y
CONFIG_SPL_LOAD_FIT=y
# CONFIG_USE_SPL_FIT_GENERATOR is not set
CONFIG_OF_BOARD_SETUP=y
CONFIG_USE_BOOTCOMMAND=y
CONFIG_BOOTCOMMAND="if test ${boot_fit} -eq 1; then run update_to_fit; fi; run findfdt; run init_console; run envboot; run distro_bootcmd"
CONFIG_LOGLEVEL=3
CONFIG_SYS_CONSOLE_INFO_QUIET=y
CONFIG_SUPPORT_RAW_INITRD=y
CONFIG_VERSION_VARIABLE=y
# CONFIG_DISPLAY_CPUINFO is not set
# CONFIG_DISPLAY_BOARDINFO is not set
CONFIG_ARCH_MISC_INIT=y
CONFIG_SPL_SYS_MALLOC_SIMPLE=y
CONFIG_SPL_SEPARATE_BSS=y
# CONFIG_SPL_BANNER_PRINT is not set
CONFIG_SPL_FIT_IMAGE_TINY=y
CONFIG_SYS_MMCSD_FS_BOOT_PARTITION=0
# CONFIG_SPL_NAND_SUPPORT is not set
CONFIG_SPL_POWER_SUPPORT=y
CONFIG_SPL_WATCHDOG_SUPPORT=y
CONFIG_SPL_YMODEM_SUPPORT=y
CONFIG_HUSH_PARSER=y
CONFIG_CMD_BOOTZ=y
# CONFIG_BOOTM_NETBSD is not set
# CONFIG_BOOTM_PLAN9 is not set
# CONFIG_BOOTM_RTEMS is not set
# CONFIG_BOOTM_VXWORKS is not set
# CONFIG_CMD_ELF is not set
CONFIG_CMD_SPL=y
CONFIG_CMD_ASKENV=y
CONFIG_CMD_DFU=y
CONFIG_CMD_DM=y
CONFIG_CMD_GPIO=y
CONFIG_CMD_GPT=y
CONFIG_CMD_I2C=y
CONFIG_CMD_MMC=y
CONFIG_CMD_PART=y
# CONFIG_CMD_SETEXPR is not set
CONFIG_CMD_DHCP=y
CONFIG_CMD_MII=y
CONFIG_CMD_PING=y
CONFIG_CMD_TIME=y
CONFIG_CMD_SYSBOOT=y
CONFIG_CMD_EXT4=y
CONFIG_CMD_EXT4_WRITE=y
CONFIG_CMD_FAT=y
CONFIG_CMD_FS_GENERIC=y
CONFIG_ISO_PARTITION=y
# CONFIG_SPL_EFI_PARTITION is not set
CONFIG_OF_CONTROL=y
CONFIG_OF_EMBED=y
CONFIG_OF_LIST="am335x-olimex-som am335x-olimex-som-evb am335x-olimex-som-nand am335x-olimex-som-evb-nand"
CONFIG_MULTI_DTB_FIT=y
CONFIG_ENV_OVERWRITE=y
CONFIG_SYS_RELOC_GD_ENV_ADDR=y
CONFIG_ENV_VARS_UBOOT_RUNTIME_CONFIG=y
CONFIG_SPL_DM=y
CONFIG_SPL_DM_SEQ_ALIAS=y
CONFIG_BOOTCOUNT_LIMIT=y
CONFIG_CLK=y
CONFIG_CLK_CDCE9XX=y
CONFIG_DM_I2C=y
# CONFIG_INPUT is not set
CONFIG_MISC=y
CONFIG_DM_MMC=y
# CONFIG_MMC_HW_PARTITIONING is not set
CONFIG_MMC_OMAP_HS=y
CONFIG_DM_ETH=y
CONFIG_DRIVER_TI_CPSW=y
CONFIG_DEBUG_UART_OMAP=y
CONFIG_DEBUG_UART_SHIFT=2
CONFIG_DEBUG_UART_ANNOUNCE=y
CONFIG_DEBUG_UART_SKIP_INIT=y
CONFIG_TIMER=y
CONFIG_OMAP_TIMER=y
CONFIG_WDT=y
# CONFIG_SPL_WDT is not set
CONFIG_FAT_WRITE=y
CONFIG_DYNAMIC_CRC_TABLE=y
# CONFIG_SPL_USE_TINY_PRINTF is not set
CONFIG_RSA=y
CONFIG_LZO=y
# CONFIG_OF_LIBFDT_OVERLAY is not set
# CONFIG_EFI_LOADER is not set
```

## configs/am335x_olimex_som_nandboot_defconfig
```kconfig
CONFIG_ARM=y
CONFIG_TARGET_AM335X_OLIMEX_SOM=y
CONFIG_SPL_STACK_R_ADDR=0x82000000
# CONFIG_SYS_MALLOC_CLEAR_ON_INIT is not set
CONFIG_NAND_BOOT=y
CONFIG_SPL=y
CONFIG_SPL_STACK_R=y
CONFIG_SYS_EXTRA_OPTIONS="NAND"
CONFIG_HUSH_PARSER=y
CONFIG_CMD_BOOTZ=y
# CONFIG_CMD_IMLS is not set
CONFIG_CMD_ASKENV=y
# CONFIG_CMD_FLASH is not set
CONFIG_CMD_MMC=y
CONFIG_CMD_GPIO=y
# CONFIG_CMD_SETEXPR is not set
CONFIG_CMD_EXT2=y
CONFIG_CMD_EXT4=y
CONFIG_CMD_EXT4_WRITE=y
CONFIG_CMD_FAT=y
CONFIG_CMD_FS_GENERIC=y
# CONFIG_CMD_NET is not set
CONFIG_SYS_NS16550=y
CONFIG_OF_LIBFDT=y
```

## configs/dogedoge_defconfig
```kconfig
CONFIG_DISTRO_DEFAULTS=n

CONFIG_ARM=y
CONFIG_ARCH_SUNXI=y
CONFIG_SPL=y
CONFIG_MACH_SUN8I_V3S=y
CONFIG_DRAM_CLK=360
CONFIG_DRAM_ZQ=14779
CONFIG_DEFAULT_DEVICE_TREE="sun8i-v3s-dogedoge"
CONFIG_SYS_USB_EVENT_POLL_VIA_INT_QUEUE=y

#spi
CONFIG_SPL_SPI_SUNXI=y
CONFIG_SPI=y
CONFIG_DM_SPI_FLASH=y
CONFIG_DM_SPI=y
CONFIG_SUNXI_SPI=y
CONFIG_CMD_SF=y
CONFIG_CMD_SPI=y
CONFIG_SPI_FLASH=y
CONFIG_SPI_FLASH_WINBOND=y
CONFIG_SPI_FLASH_MTD=y

#environment
CONFIG_ENV_IS_IN_FAT=n
CONFIG_ENV_IS_IN_SPI_FLASH=y
CONFIG_ENV_OFFSET=0x40000
CONFIG_ENV_SIZE=0x8000
CONFIG_ENV_SECT_SIZE=0x1000

#bits for loading from sd
CONFIG_CMD_EXT4=y
CONFIG_DOS_PARTITION=y

#misc
CONFIG_NET=n
CONFIG_FIT=y
CONFIG_CMD_NET=n
CONFIG_CMD_GPT=n
CONFIG_EFI_LOADER=n
CONFIG_EFI_PARTITION=n
CONFIG_CMD_ELF=n
CONFIG_CMD_BOOTZ=y
CONFIG_CMD_LOADB=n
CONFIG_CMD_LOADS=n
CONFIG_CMD_FLASH=n
```

## configs/eltec-e17_defconfig
```kconfig
CONFIG_M68K=y
CONFIG_TEXT_BASE=0X600000
CONFIG_SPL_LIBCOMMON_SUPPORT=y
CONFIG_SPL_LIBGENERIC_SUPPORT=y
CONFIG_NR_DRAM_BANKS=1
CONFIG_DEFAULT_DEVICE_TREE="eltec-e17"
CONFIG_SPL_TEXT_BASE=0x400000
CONFIG_SPL_BSS_MAX_SIZE=0x8000
CONFIG_BOOTSTAGE_STASH_ADDR=0
CONFIG_DEBUG_UART_CLOCK=0
CONFIG_SYS_LOAD_ADDR=0x400
CONFIG_TARGET_E17=y
# CONFIG_MCFTMR is not set
CONFIG_DEBUG_UART=y
CONFIG_LTO=y
CONFIG_SYS_UBOOT_START=0x0
CONFIG_SYS_MONITOR_BASE=0x600000
# CONFIG_LEGACY_IMAGE_FORMAT is not set
CONFIG_LOG=y
CONFIG_SPL_LOG=y
CONFIG_CYCLIC_MAX_CPU_TIME_US=1000
CONFIG_BOARD_EARLY_INIT_R=y
CONFIG_STACKPROTECTOR=y
CONFIG_SPL_MAX_SIZE=0x100000
CONFIG_SPL_PAD_TO=0x0
CONFIG_SPL_YMODEM_SUPPORT=y
CONFIG_SYS_PROMPT="e17 =>"
# CONFIG_BOOTM_NETBSD is not set
# CONFIG_BOOTM_PLAN9 is not set
# CONFIG_BOOTM_RTEMS is not set
# CONFIG_BOOTM_VXWORKS is not set
CONFIG_CMD_ELF_FDT_SETUP=y
# CONFIG_CMD_ELF_BOOTVX is not set
CONFIG_CMD_UNLZ4=y
CONFIG_CMD_DHCP=y
CONFIG_CMD_CACHE=y
CONFIG_DOS_PARTITION=y
# CONFIG_SPL_DOS_PARTITION is not set
CONFIG_EFI_PARTITION=y
# CONFIG_SPL_EFI_PARTITION is not set
CONFIG_SPL_OF_CONTROL=y
CONFIG_OF_EMBED=y
CONFIG_NET_RANDOM_ETHADDR=y
CONFIG_SPL_DM=y
CONFIG_DM_WARN=y
CONFIG_SPL_DM_SEQ_ALIAS=y
CONFIG_REGMAP=y
CONFIG_SPL_REGMAP=y
CONFIG_SYSCON=y
CONFIG_SPL_SYSCON=y
CONFIG_SPL_OF_TRANSLATE=y
# CONFIG_GPIO is not set
# CONFIG_I2C is not set
# CONFIG_INPUT is not set
CONFIG_MISC=y
CONFIG_QEMU_VIRT_CTRL=y
# CONFIG_POWER is not set
CONFIG_SPECIFY_CONSOLE_INDEX=y
CONFIG_SERIAL_SEARCH_ALL=y
CONFIG_DEBUG_CD2401_SERIAL=y
CONFIG_DEBUG_UART_ANNOUNCE=y
CONFIG_SPL_TIMER=y
CONFIG_PCC_TIMER=y
# CONFIG_WATCHDOG is not set
CONFIG_FS_FAT=y
# CONFIG_SPL_USE_TINY_PRINTF is not set
CONFIG_SPL_CRC32=y
# CONFIG_GZIP is not set
CONFIG_OF_LIBFDT_ASSUME_MASK=0
CONFIG_LMB_MAX_REGIONS=8
# CONFIG_TOOLS_LIBCRYPTO is not set
# CONFIG_TOOLS_KWBIMAGE is not set
```

## configs/kanpapa_defconfig
```kconfig
CONFIG_M68K=y
CONFIG_TEXT_BASE=0x0
CONFIG_SYS_MALLOC_LEN=0x100000
CONFIG_NR_DRAM_BANKS=1
CONFIG_DM_GPIO=y
CONFIG_DEFAULT_DEVICE_TREE="kanpapa-mc68ez328sbc"
CONFIG_SPL_TEXT_BASE=0x400000
CONFIG_BOOTSTAGE_STASH_ADDR=0
CONFIG_SYS_LOAD_ADDR=0x400
CONFIG_TARGET_MC68EZ328SBC=y
# CONFIG_MCFTMR is not set
CONFIG_OF_BOARD_FIXUP=y
CONFIG_LTO=y
CONFIG_REMAKE_ELF=y
CONFIG_STACK_SIZE=0x80000
CONFIG_SYS_UBOOT_START=0x400
# CONFIG_TIMESTAMP is not set
# CONFIG_BOOTSTD is not set
# CONFIG_LEGACY_IMAGE_FORMAT is not set
CONFIG_BOARD_EARLY_INIT_R=y
CONFIG_STACKPROTECTOR=y
CONFIG_SPL_MAX_SIZE=0x10000
CONFIG_SPL_PAD_TO=0x0
CONFIG_SPL_BSS_MAX_SIZE=0x4000
# CONFIG_SPL_RAW_IMAGE_SUPPORT is not set
CONFIG_SPL_LEGACY_IMAGE_CRC_CHECK=y
CONFIG_SPL_HAS_CUSTOM_MALLOC_START=y
CONFIG_SPL_CUSTOM_SYS_MALLOC_ADDR=0x500000
CONFIG_SYS_MAXARGS=16
# CONFIG_CMD_BOOTD is not set
# CONFIG_CMD_BOOTM is not set
# CONFIG_CMD_ELF_BOOTVX is not set
# CONFIG_CMD_IMI is not set
# CONFIG_CMD_XIMG is not set
# CONFIG_CMD_EXPORTENV is not set
# CONFIG_CMD_IMPORTENV is not set
# CONFIG_CMD_EDITENV is not set
# CONFIG_CMD_SAVEENV is not set
# CONFIG_CMD_ENV_EXISTS is not set
# CONFIG_CMD_CRC32 is not set
CONFIG_CMD_UNLZ4=y
CONFIG_CMD_CLK=y
CONFIG_CMD_DM=y
CONFIG_CMD_GPIO=y
CONFIG_CMD_PWM=y
# CONFIG_CMD_LOADS is not set
CONFIG_CMD_MMC=y
CONFIG_CMD_PART=y
CONFIG_CMD_SPI=y
CONFIG_CMD_RTC=y
CONFIG_CMD_REGULATOR=y
CONFIG_CMD_FAT=y
# CONFIG_SPL_DOS_PARTITION is not set
CONFIG_EFI_PARTITION=y
# CONFIG_SPL_EFI_PARTITION is not set
CONFIG_OF_EMBED=y
# CONFIG_NET is not set
CONFIG_DM_WARN=y
CONFIG_SPL_OF_TRANSLATE=y
CONFIG_CLK=y
CONFIG_DRAGONBALL_GPIO=y
# CONFIG_I2C is not set
# CONFIG_INPUT is not set
CONFIG_LED=y
CONFIG_LED_GPIO=y
CONFIG_MISC=y
CONFIG_DRAGONBALL_INTC=y
CONFIG_MMC=y
CONFIG_MMC_SPI=y
# CONFIG_MMC_HW_PARTITIONING is not set
CONFIG_MTD=y
CONFIG_MTD_NOR_FLASH=y
CONFIG_FLASH_CFI_DRIVER=y
CONFIG_SYS_CFI_FLASH_STATUS_POLL=y
CONFIG_SYS_FLASH_USE_BUFFER_WRITE=y
CONFIG_DM_REGULATOR=y
CONFIG_DM_REGULATOR_FIXED=y
CONFIG_DM_PWM=y
CONFIG_PWM_DRAGONBALL=y
CONFIG_DM_RTC=y
CONFIG_RTC_DRAGONBALL=y
CONFIG_RTC_DS1305=y
CONFIG_BAUDRATE=9600
CONFIG_SPECIFY_CONSOLE_INDEX=y
CONFIG_SERIAL_RX_BUFFER=y
CONFIG_SERIAL_SEARCH_ALL=y
CONFIG_SPI=y
CONFIG_DM_SPI=y
CONFIG_DRAGONBALL_SPI=y
# CONFIG_SPL_USE_TINY_PRINTF is not set
CONFIG_REGEX=y
# CONFIG_GZIP is not set
CONFIG_OF_LIBFDT_ASSUME_MASK=0
CONFIG_LMB_MAX_REGIONS=8
# CONFIG_TOOLS_KWBIMAGE is not set
```

## configs/mercury5_defconfig
```kconfig
CONFIG_ARM=y
CONFIG_ARCH_MSTAR=y
CONFIG_MSTAR_MERCURY5=y

# control dtb
CONFIG_DEFAULT_DEVICE_TREE="mercury5"
CONFIG_MULTI_DTB_FIT=y
CONFIG_OF_LIST="chenxing-v7 mercury5"

#env
CONFIG_ENV_IS_IN_FAT=y
CONFIG_ENV_FAT_INTERFACE="mmc"
CONFIG_ENV_FAT_DEVICE_AND_PART="0:1"

#prevent junk from the uart bridge stopping auto boot
CONFIG_AUTOBOOT_KEYED=y
#CONFIG_AUTOBOOT_KEYED_CTRLC=y
CONFIG_AUTOBOOT_STOP_STR="bzzbzz"
CONFIG_BOOTDELAY=10

#logging
CONFIG_LOG=y

#memory
CONFIG_NR_DRAM_BANKS=1
CONFIG_SYS_TEXT_BASE=0x20008000

#spl options
CONFIG_MSTAR_IPL=n
CONFIG_SPL_LEGACY_IMAGE_CRC_CHECK=y
#CONFIG_SPL_SPI_FLASH_SUPPORT=y
#CONFIG_SPL_SPI_LOAD=y
#CONFIG_SPL_SPI_SUPPORT=y 
CONFIG_SPL_DM_SEQ_ALIAS=y
#CONFIG_SPL_MTD_SUPPORT=y
#CONFIG_SPL_YMODEM_SUPPORT=y
CONFIG_SPL_OF_TRANSLATE=y
CONFIG_SPL_RAW_IMAGE_SUPPORT=n
CONFIG_SPL_SYS_THUMB_BUILD=y
CONFIG_SPL_SYS_MALLOC_SIMPLE=y
CONFIG_SPL_REGMAP=y
CONFIG_SPL_MMC_SUPPORT=y
CONFIG_SPL_MMC_TINY=y
CONFIG_SPL_FS_FAT=y
CONFIG_SPL_USE_ARCH_MEMCPY=n
CONFIG_SPL_USE_ARCH_MEMSET=n
CONFIG_SPL_LIBDISK_SUPPORT=y

#network
CONFIG_DM_ETH=y
CONFIG_MACB=y
#CONFIG_MACB_MSTAR=y
CONFIG_CMD_DHCP=y
CONFIG_NET_RANDOM_ETHADDR=y
CONFIG_MII=y

#spi flash
CONFIG_SPI=y
CONFIG_DM_SPI=y
CONFIG_MTD=y
CONFIG_DM_SPI_FLASH=y
CONFIG_MSTAR_MSC313SPINOR=y
CONFIG_CMD_SF=y
CONFIG_SPI_FLASH=y
CONFIG_SPI_FLASH_MTD=y
CONFIG_SPI_FLASH_BAR=y
CONFIG_SPI_FLASH_WINBOND=y
CONFIG_SPI_FLASH_GIGADEVICE=y
#this is needed because the env is only 8K
#and sf won't do a sector erase instead
#of a block erase
CONFIG_SPI_FLASH_USE_4K_SECTORS=y

#debugging/bring up
#CONFIG_OF_EMBED=y
#CONFIG_LOGLEVEL=9
#CONFIG_LOG_MAX_LEVEL=9
#CONFIG_LOG_DEFAULT_LEVEL=9
#CONFIG_DEBUG_LL=y
#CONFIG_DEBUG_LL_UART_8250=y
#CONFIG_DEBUG_UART_PHYS=0x1f221000
#CONFIG_DEBUG_UART_8250_SHIFT=3

CONFIG_DEBUG_UART=y
#CONFIG_DEBUG_UART_SKIP_INIT=y
#CONFIG_REQUIRE_SERIAL_CONSOLE=n
#CONFIG_DM_DEBUG=y
CONFIG_CMD_DM=y
#CONFIG_HEXDUMP=y
CONFIG_CMD_CACHE=y

#handy things
CONFIG_HUSH_PARSER=y

#linux booting
CONFIG_CMD_BOOTZ=y

#unneeded stuff
CONFIG_CMD_BOOTEFI=n
CONFIG_CMD_ELF=n
CONFIG_GZIP=n
CONFIG_INPUT=n
CONFIG_CMD_NVEDIT_EFI=n
CONFIG_EFI_LOADER=n
CONFIG_CMD_NFS=n
CONFIG_CMD_FLASH=n

CONFIG_SPI_BOOT=y

CONFIG_CMD_DHRYSTONE=y

# mmc
CONFIG_REGMAP=y
CONFIG_MMC=y
CONFIG_DM_MMC=y
#CONFIG_MMC_TRACE=y
CONFIG_MMC_MSTAR=y
CONFIG_CMD_MMC=y
CONFIG_CMD_FAT=y
CONFIG_FS_FAT_MAX_CLUSTSIZE=4096

#CONFIG_TIMER=y
#CONFIG_SPL_TIMER=y
```

## configs/msc313_breadbee_defconfig
```kconfig
CONFIG_ARM=y
CONFIG_ARCH_MSTAR=y
CONFIG_TARGET_BREADBEE=y
CONFIG_SYS_MALLOC_F_LEN=0x3000
CONFIG_SYS_MALLOC_LEN=0x40000
CONFIG_SYS_TEXT_BASE=0x20000000
CONFIG_FIT=y
CONFIG_OF_LIBFDT=y
CONFIG_OF_CONTROL=y
CONFIG_OF_LIBFDT_OVERLAY=y
CONFIG_OF_BOARD_SETUP=y

# control dtb
CONFIG_DEFAULT_DEVICE_TREE="mstar-v7"
CONFIG_MULTI_DTB_FIT=y
CONFIG_OF_LIST="mstar-v7 infinity1 infinity3"
CONFIG_DTB_RESELECT=y

#env
#CONFIG_ENV_IS_NOWHERE=y
CONFIG_ENV_IS_IN_SPI_FLASH=y
CONFIG_CMD_SAVEENV=y


#prevent junk from the uart bridge stopping auto boot
CONFIG_AUTOBOOT_KEYED=y
#CONFIG_AUTOBOOT_KEYED_CTRLC=y
CONFIG_AUTOBOOT_STOP_STR="bzzbzz"
CONFIG_BOOTDELAY=10

#logging
CONFIG_LOG=y

#memory
CONFIG_NR_DRAM_BANKS=1


#spl options
CONFIG_MSTAR_IPL=y
CONFIG_SPL=y
CONFIG_SPL_OF_CONTROL=y
CONFIG_SPL_LEGACY_IMAGE_CRC_CHECK=y
CONFIG_SPL_SPI_FLASH_SUPPORT=y
CONFIG_SPL_SPI_LOAD=y
CONFIG_SPL_SPI_SUPPORT=y 
CONFIG_SPL_DM_SEQ_ALIAS=y
CONFIG_SPL_MTD_SUPPORT=y
CONFIG_SPL_YMODEM_SUPPORT=y
CONFIG_SPL_OF_TRANSLATE=y
CONFIG_SPL_RAW_IMAGE_SUPPORT=n
CONFIG_SPL_SYS_THUMB_BUILD=y
CONFIG_SPL_SYS_MALLOC_SIMPLE=y

#spi flash
CONFIG_SPI=y
CONFIG_DM_SPI=y
CONFIG_MTD=y
CONFIG_DM_SPI_FLASH=y
CONFIG_MSTAR_MSC313SPINOR=y
CONFIG_CMD_SF=y
CONFIG_SPI_FLASH=y
CONFIG_SPI_FLASH_MTD=y
CONFIG_SPI_FLASH_BAR=y
CONFIG_SPI_FLASH_WINBOND=y
CONFIG_SPI_FLASH_GIGADEVICE=y
#this is needed because the env is only 8K
#and sf won't do a sector erase instead
#of a block erase
CONFIG_SPI_FLASH_USE_4K_SECTORS=y

#debugging/bring up
#CONFIG_OF_EMBED=y
#CONFIG_LOGLEVEL=9
#CONFIG_LOG_MAX_LEVEL=9
#CONFIG_LOG_DEFAULT_LEVEL=9
#CONFIG_DM_DEBUG=y
CONFIG_CMD_DM=y
#CONFIG_MMC_TRACE=y
CONFIG_HEXDUMP=y
CONFIG_CMD_PING=y

#handy things
CONFIG_HUSH_PARSER=y

#linux booting
CONFIG_CMD_BOOTZ=y

#unneeded stuff
CONFIG_CMD_BOOTEFI=n
CONFIG_CMD_ELF=n
CONFIG_GZIP=n
CONFIG_INPUT=n
CONFIG_CMD_NVEDIT_EFI=n
CONFIG_EFI_LOADER=n
CONFIG_CMD_NFS=n
CONFIG_CMD_FLASH=n

CONFIG_SPI_BOOT=y
CONFIG_CMD_DHRYSTONE=y

#mmc
CONFIG_REGMAP=y
CONFIG_MMC=y
CONFIG_DM_MMC=y
CONFIG_MMC_MSTAR=y
CONFIG_CMD_MMC=y
CONFIG_CMD_FAT=y

CONFIG_CMD_CACHE=y

#ram
CONFIG_RAM=y
```

## configs/mstar_infinity2m_som2d01_defconfig
```kconfig
CONFIG_ARM=y
CONFIG_ARCH_MSTARV7=y
CONFIG_MSTAR_INFINITY2M=y
CONFIG_TARGET_SOM2D01=y
CONFIG_MSTAR_IPL=y

#CONFIG_SPL_TEXT_BASE=0xa0000000


CONFIG_CMD_MTD=y

CONFIG_SPL_DM_SPI_FLASH=n
CONFIG_SPL_SPI_FLASH_SUPPORT=n

CONFIG_DYNAMIC_CRC_TABLE=y
CONFIG_SPL_LEGACY_IMAGE_CRC_CHECK=y

CONFIG_MTD_UBI_FASTMAP=y
#CONFIG_MTD_UBI=n
#CONFIG_CMD_UBI=n

# environment
CONFIG_ENV_IS_NOWHERE=n
CONFIG_ENV_IS_IN_UBI=y
CONFIG_ENV_UBI_PART="UBI"
CONFIG_ENV_UBI_VOLUME="env"

CONFIG_SPL_OPTIMIZE_INLINING=y

CONFIG_EFI_LOADER=n
CONFIG_INPUT=n
CONFIG_SPL_USE_ARCH_MEMCPY=n
```
