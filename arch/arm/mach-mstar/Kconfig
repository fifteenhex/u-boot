## configs/mstar_infinity2m_unitv2_defconfig
```kconfig
CONFIG_ARM=y
CONFIG_ARCH_MSTARV7=y
CONFIG_MSTAR_IPL=y
CONFIG_MSTAR_INFINITY2M=y
CONFIG_TARGET_UNITV2=y
CONFIG_DEFAULT_DEVICE_TREE="mstar-infinity2m-ssd201"
CONFIG_OF_LIST="mstar-infinity2m-ssd201 mstar-infinity2m-ssd202d"

#CONFIG_SPL_TEXT_BASE=0xa0000000


CONFIG_CMD_MTD=y

CONFIG_SPL_DM_SPI_FLASH=n
CONFIG_SPL_SPI_FLASH_SUPPORT=n

CONFIG_SPL_LEGACY_IMAGE_CRC_CHECK=y





# environment
#CONFIG_ENV_IS_NOWHERE=y
CONFIG_ENV_IS_IN_UBI=y
CONFIG_ENV_UBI_PART="UBI"
CONFIG_ENV_UBI_VOLUME="env"
```
