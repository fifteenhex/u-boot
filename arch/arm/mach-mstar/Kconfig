## arch/arm/mach-mstar/Kconfig
```kconfig
menu "MStar/SigmaStar v7 options"
	depends on ARCH_MSTARV7

config MSTAR_USBUPDATER
	bool "u-boot is being loader by the usb updater"

config MSTAR_IPL
	bool "u-boot is being loaded by the vendor IPL"
	imply SPI
	imply DM_SPI
	imply DM_SPI_FLASH
	imply MSTAR_MSC313SPINOR
	imply SPL_SPI_SUPPORT
	imply SPL_SPI_FLASH_SUPPORT
	imply SPL_DM_SPI
	imply SPL_DM_SPI_FLASH
	imply SPI_FLASH_WINBOND
	imply SPL_SPI_NAND_SUPPORT
	imply MTD
	imply CMD_MTDPARTS
	imply MTD_UBI
	imply CMD_UBI
	imply DM_MTD
	imply MTD_SPI_NAND
	imply SPL_MTD_SUPPORT
	imply SPL_YMODEM_SUPPORT
	imply DM_ETH
	imply MACB
	imply NET_RANDOM_ETHADDR
	imply MII
	imply PHY_MSTAR
	imply CMD_DHCP
	select SPL_STACK_R
	help
	  Say y here if you are loading u-boot via the vendor
	  IPL. Note that the image can only be 48KB or less
	  for the IPL to load it so this only really applies
	  to a SPL/TPL.

config MSTAR_BANG_BOOT0
	bool "Output a bang in boot0"
	help
	  Say y here if you are want to output a bang from
	  boot0 on pm_uart. This makes it easier to see if
	  the boot rom or IPL jumped to our code correctly
	  or not.

config MSTAR_ENABLE_JTAG_BOOT0
	bool "Enable JTAG in boot0 for debugging very early"
	help
	  Say y here if you are want to debug via JTAG very
	  early in the boot process, right after the boot rom
	  or IPL have passed control the the u-boot SPL.

config MSTAR_MSTAR_BREAK_BOOT0
	bool "break early in boot0"
	depends on MSTAR_ENABLE_JTAG_BOOT0
	help
	  Say y here if you are want a breakpoint added before
	  boot0 starts the normal u-boot startup code. This allows
	  you to setup your JTAG probe just after JTAG was enabled
	  but before a lot of code has executed.

config MSTAR_INFINITY1
	bool "infinity1 family"

config MSTAR_INFINITY2M
	bool "infinity2m family"

config MSTAR_INFINITY3
	bool "infinity3 family"

config MSTAR_INFINITY6
	bool "infinity6 family"

config MSTAR_MERCURY5
	bool "mercury5 family"

config MSTAR_PIONEER3
	bool "pioneer3 family"

# Should select the bare minimum that is needed for anything to happen
config MSTARV7_BASE
	bool
	select MULTI_DTB_FIT
#	select FDT_FIXUP_PARTITIONS
	select SPL_STACK_R
	select SPL_OPTIMIZE_INLINING
	select MSTAR_MIU
	# Options to keep the SPL size down
	select SPL_SYS_ICACHE_OFF
	select SPL_SYS_DCACHE_OFF
	select SPL_OF_PLATDATA

# Should be selected by everyone but p3
config MSTARV7_COMMON
	bool
	select MSTARV7_BASE
	select SPL_YMODEM_SUPPORT

config MSTARV7_SPI_UBOOT
	bool
	select DM_SPI
	select SPI
	select MSTAR_MSC313SPINOR

config MSTARV7_SPIBOOT
	bool
	select MSTARV7_SPI_UBOOT
	select SPL_DM_SPI
	select SPL_SPI
	select SPL_LEGACY_IMAGE_CRC_CHECK

config MSTARV7_SPINAND_UBOOT
	bool
	select MSTARV7_SPI_UBOOT
	select CMD_UBI
	select CMD_MTD
	select CMD_MTDPARTS
	select DM_MTD
	select MTD
	select MTD_UBI
	select MTD_UBI_FASTMAP
	select MTD_SPI_NAND
	select ENV_IS_IN_UBI

# Enough to just read SPI NAND in the SPL
config MSTARV7_SPINAND_SPL
	bool
	select SPL_SPI_NAND_SUPPORT
	select SPL_MTD_SUPPORT

# Options to load u-boot from raw SPI NAND pages
# in the SPL
config MSTARV7_SPINAND_SPL_RAW
	bool
	select MSTARV7_SPINAND_SPL

# Options for full UBI in the SPL
config MSTARV7_SPINAND_SPL_UBI
	bool
	select MSTARV7_SPINAND_SPL
	select SPL_UBI
#	select UBI_SPL_SILENCE_MSG

# For P3 where the SRAM is tiny
config MSTARV7_SPINAND_SMALL
	bool
	select MSTARV7_SPIBOOT
	select MSTARV7_SPINAND_UBOOT
	select MSTARV7_SPINAND_SPL_RAW

config MSTARV7_SPINAND
	bool
	select MSTARV7_SPIBOOT
	select MSTARV7_SPINAND_UBOOT
	select MSTARV7_SPINAND_SPL_UBI

choice
     prompt "Board type"

config TARGET_MSTARV7
	bool "Generic MStar/SigmaStar v7 boards"
	select MSTARV7_COMMON
	select SPL_SPI

config TARGET_BREADBEE
	bool "Support breadbee boards"
	depends on !MSTAR_MERCURY5
	depends on !MSTAR_INFINITY2M
	select MSTARV7_COMMON
	select SPL_DM_SPI
	select MSTAR_INFINITY1
	select MSTAR_INFINITY3
	select DM_ETH
	select MACB
	select CMD_DHCP
	select NET_RANDOM_ETHADDR
	select MII
	select PHY_MSTAR
	select REGMAP
	select MMC
	select DM_MMC
	select MMC_MSTAR
	select CMD_MMC
	select CMD_FAT
	select SPI_FLASH_USE_4K_SECTORS

if MSTAR_INFINITY2M
config TARGET_DONGSHANPIONE
	bool "Support DongShanPiOne"
	select MSTARV7_COMMON
	select PINCTRL
	select PINCTRL_MSTAR
	select MMC_MSTAR
	select SPL_UBI
	select MTD_UBI_FASTMAP
	select ENV_IS_IN_UBI
	select CMD_MMC
	select CMD_GPIO
	select USB
	select USB_EHCI_HCD
	select USB_EHCI_FARADAY
	select PHY
	select PHY_MSC313_USB
	select CMD_USB
	select CMD_DM
	select USB_HOST_ETHER
	select USB_ETHER_RTL8152
	select CMD_EXT4
	select CMD_FAT
	select WATCHDOG
	select WDT

config TARGET_SOM2D01
	bool "Support SOM2D01"
	select MSTARV7_COMMON
	select PINCTRL
	select PINCTRL_MSTAR
	select MMC_MSTAR
	select SPL_SPI
	select SPL_UBI
	select MTD_UBI_FASTMAP
	select ENV_IS_IN_UBI

config TARGET_UNITV2
	bool "UnitV2"
	select MSTARV7_COMMON
	select PINCTRL
	select PINCTRL_MSTAR
	select MMC_MSTAR
	select SPL_SPI
	select SPL_UBI
	select MTD_UBI_FASTMAP
	select ENV_IS_IN_UBI

config TARGET_MIYOOMINI
	bool "Miyoo Mini"
	select MSTARV7_COMMON
	select PINCTRL
	select PINCTRL_MSTAR
	select MMC_MSTAR
	select SPL_SPI
endif

if MSTAR_PIONEER3
config TARGET_PREDITA
	bool "Predita"
	select MSTARV7_COMMON
	select MSTARV7_SPINAND
	select PINCTRL
	select PINCTRL_MSTAR

config TARGET_DONGSHANPIPICOW
	bool "DongShanPi PicoW"
	select MSTARV7_COMMON
	select MSTARV7_SPINAND
	select PINCTRL
	select PINCTRL_MSTAR
	select SPL_SPI_NAND_SUPPORT_WINBOND
endif

endchoice

endmenu

if ARCH_MSTARV7

config NR_DRAM_BANKS
	default 1

config SPL_LDSCRIPT
	default "arch/arm/mach-mstar/u-boot-spl.lds"

config SPL_TEXT_BASE
	default 0x23c00000 if MSTAR_IPL
	default 0xa0000000

# Set the text base to the bottom of DRAM + 1K before
# for any headers that might be attached to start of
# the u-boot image
config SYS_TEXT_BASE
	default 0x20001000

# Because the SRAM is pretty small we need to start using
# the DRAM for stack and heap as soon as possible.
# There is always at least 64MB of DRAM so put our new
# stack there.
config SPL_STACK_R_ADDR
	default 0x24000000
# 8MiB below that put the UBI info
config SPL_UBI_INFO_ADDR
	default 0x23800000
#

config ENV_SIZE
	default 0x2000

config ENV_OFFSET
	default 0x2000

config ENV_SECT_SIZE
	default 4096

config SYS_SPI_U_BOOT_OFFS
	default 0x20000

# For ubi we need a fair bit of heap
config SYS_MALLOC_LEN
	default 0x1000000

config SYS_MALLOC_F_LEN
	default 0x2000

config FS_FAT_MAX_CLUSTSIZE
	default 4096

config DEBUG_UART_BASE
	default 0x1f221000

config DEBUG_UART_CLOCK
	default 172000000

config DEBUG_UART_SHIFT
	default 3

config SPL_SIZE_LIMIT
	#For p3 the SRAM is 0xe000 long but the bootrom has variables at 0x7800
	default 0x7800 if MSTAR_PIONEER3
	#For i2m the SRAM is 0x10000 long but the bootrom has variables at 0xa000
	default 0xc000

config SYS_SOC
	default "mstarv7"

config SYS_LOAD_ADDR
	default 0x24000000

# Update some defaults
config EFI_LOADER
	default n

endif
```

## arch/m68k/Kconfig
```kconfig
menu "M68000 architecture"
	depends on M68K

config SYS_ARCH
	default "m68k"

config STATIC_RELA
	default y

config M68K_HAVE_VBAR
	bool

config M68K_HAVE_BOOTINFO
	bool

# processor family
config MC68000
	bool
	select OF_CONTROL
	select DM
	select DM_SERIAL
	select TIMER
	select HAVE_SYS_UBOOT_START

config MCF520x
	select OF_CONTROL
	select DM
        select DM_SERIAL
	bool

config MCF52x2
	select OF_CONTROL
	select DM
        select DM_SERIAL
	bool

config MCF523x
	select OF_CONTROL
	select DM
        select DM_SERIAL
	bool

config MCF530x
	select OF_CONTROL
	select DM
        select DM_SERIAL
	bool

config MCF5301x
	select OF_CONTROL
	select DM
        select DM_SERIAL
	bool

config MCF532x
	select OF_CONTROL
	select DM
        select DM_SERIAL
	bool

config MCF537x
	select OF_CONTROL
	select DM
        select DM_SERIAL
	bool

config MCF5441x
	select OF_CONTROL
	select DM
        select DM_SERIAL
	bool

# processor type
config MC68EZ328
	bool
	select MC68000
	select SUPPORT_SPL
	select SPL_SYS_MALLOC
	select SPL_OF_CONTROL
	select SPL_DM
	select SPL_DM_SEQ_ALIAS
	select SPL_FRAMEWORK_BOARD_INIT_F
	select SPL_LIBGENERIC_SUPPORT
	select SPL_LIBCOMMON_SUPPORT
	select SPL_SERIAL
	select SPL_YMODEM_SUPPORT
	select DRAGONBALL_SERIAL
	select SPL_TIMER
	select CMD_LOADB
	select DRAGONBALL_TIMER
	select CLK_DRAGONBALL_PLL

config M5208
	bool
	select MCF520x

config M5235
	bool
	select MCF523x

config M5249
	bool
	select MCF52x2

config M5253
	bool
	select MCF52x2

config M5271
	bool
	select MCF52x2

config M5272
	bool
	select MCF52x2

config M5275
	bool
	select MCF52x2

config M5282
	bool
	select MCF52x2

config M5307
	bool
	select MCF530x

config M53015
	bool
	select MCF5301x

config M5329
	bool
	select MCF532x

config M5373
	bool
	select MCF532x
	select MCF537x

config M54418
	bool
	select MCF5441x

config MC68030
	bool
#	select MC680x0
	select MC68000
	select M68K_HAVE_VBAR
	select M68K_HAVE_BOOTINFO

# peripherals
config CF_DSPI
	bool

choice
	prompt "Target select"
	optional

config TARGET_M5235EVB
	bool "Support M5235EVB"
	select M5235

config TARGET_COBRA5272
	bool "Support cobra5272"
	select M5272

config TARGET_EB_CPU5282
	bool "Support eb_cpu5282"
	select M5282
	select HW_WATCHDOG

config TARGET_M5208EVBE
	bool "Support M5208EVBE"
	select M5208

config TARGET_M5249EVB
	bool "Support M5249EVB"
	select M5249

config TARGET_M5253DEMO
	bool "Support M5253DEMO"
	select M5253

config TARGET_M5272C3
	bool "Support M5272C3"
	select M5272

config TARGET_M5275EVB
	bool "Support M5275EVB"
	select M5275

config TARGET_M5282EVB
	bool "Support M5282EVB"
	select M5282

config TARGET_M53017EVB
	bool "Support M53017EVB"
	select M53015

config TARGET_M5329EVB
	bool "Support M5329EVB"
	select M5329

config TARGET_M5373EVB
	bool "Support M5373EVB"
	select M5373

config TARGET_AMCORE
	bool "Support AMCORE"
	select M5307

config TARGET_STMARK2
        bool "Support stmark2"
        select CF_DSPI
        select M54418

config TARGET_QEMU
	bool "Support QEMU virt machine"
	select MC68000

	# For populating the DT with the bootinfo data
	select OF_BOARD_FIXUP

	# For RTC and timer
	select DM_RTC
	select RTC_GOLDFISH
	select GOLDFISH_TIMER

	# For setting up the virt ctrl
	select BOARD_EARLY_INIT_R
	select MISC
	select QEMU_VIRT_CTRL

	select BLK
	select VIRTIO_MMIO
	select VIRTIO_BLK

	# Cpu type doesn't select it
	select M68K_HAVE_BOOTINFO

config TARGET_MC68EZ328SBC
	bool "Support kanpapa MC68EZ328 SBC"
	select MC68EZ328
	select SPL

config TARGET_MVME147
	bool "Support Motorola MVME147"
	select MC68000
	select MC68030
	select SUPPORT_SPL

	# For populating the DT with the bootinfo data
	select OF_BOARD_FIXUP
	select SPL
	select SPL_FRAMEWORK_BOARD_INIT_F

	# Essential drivers
	select WDT_PCC
	select PCC_TIMER
	select SCC_SERIAL

	# For booting from SCSI
	select SPL_SATA
	select SCSI_WD33C93
	select SPL_DOS_PARTITION

	# For network
	select LANCE
	select LANCE_LANCE

config TARGET_E17
	bool "Support ELTEC E17"
	select MC68000
	select MC68040
	select SUPPORT_SPL
	select CD2401_SERIAL
	select Z8536_TIMER
	select LANCE
	select LANCE_ILACC
	select WDT
	select WDT_MMIO

	# For populating the DT with the bootinfo data
	select OF_BOARD_FIXUP
	select SPL
	select SPL_FRAMEWORK_BOARD_INIT_F
	select SPL_SERIAL

endchoice

source "board/BuS/eb_cpu5282/Kconfig"
source "board/cobra5272/Kconfig"
source "board/freescale/m5208evbe/Kconfig"
source "board/freescale/m5235evb/Kconfig"
source "board/freescale/m5249evb/Kconfig"
source "board/freescale/m5253demo/Kconfig"
source "board/freescale/m5272c3/Kconfig"
source "board/freescale/m5275evb/Kconfig"
source "board/freescale/m5282evb/Kconfig"
source "board/freescale/m53017evb/Kconfig"
source "board/freescale/m5329evb/Kconfig"
source "board/freescale/m5373evb/Kconfig"
source "board/sysam/amcore/Kconfig"
source "board/sysam/stmark2/Kconfig"
source "board/qemu/virt-m68k/Kconfig"
source "board/kanpapa/mc68ez328sbc/Kconfig"
source "board/motorola/mvme147/Kconfig"
source "board/eltec/e17/Kconfig"

config M68K_QEMU
	bool "Build with workarounds for incomplete QEMU emulation"
	help
	  QEMU 8.x currently does not implement RAMBAR accesses and
	  DMA timers. Enable this option for U-Boot CI purposes only
	  to skip the RAMBAR accesses.

config MCFTMR
	bool "Use DMA timer"
	default y if !M68K_QEMU
	default n if M68K_QEMU

endmenu
```

## board/100ask/dongshanpione/Kconfig
```kconfig
if TARGET_DONGSHANPIONE

config SYS_BOARD
	default "dongshanpione"

config SYS_VENDOR
	default "100ask"

config SYS_CONFIG_NAME
	default "dongshanpione"

config OF_LIST
	default "mstar-infinity2m-ssd202d-100ask-dongshanpione"

config DEFAULT_DEVICE_TREE
	default "mstar-infinity2m-ssd202d-100ask-dongshanpione"

config MTDPARTS_DEFAULT
	default "spi-nand0:128256K@2816K(UBI)"

endif
```

## board/100ask/dongshanpipicow/Kconfig
```kconfig
if TARGET_DONGSHANPIPICOW

config SYS_BOARD
	default "dongshanpipicow"

config SYS_VENDOR
	default "100ask"

config SYS_CONFIG_NAME
	default "dongshanpipicow"

config BOARD_SPECIFIC_OPTIONS # dummy
	def_bool y

config OF_LIST
	default "mstar-pioneer3-ssd210-100ask-dongshanpipicow"

config DEFAULT_DEVICE_TREE
	default "mstar-pioneer3-ssd210-100ask-dongshanpipicow"

config ENV_UBI_PART
	default "ubi"

config ENV_UBI_VOLUME
	default "env"

config SPL_UBI_MAX_VOL_LEBS
        default 256
config SPL_UBI_MAX_PEB_SIZE
        default 131072
# Enough for 128MB
config SPL_UBI_MAX_PEBS
        default 1024
config SPL_UBI_VOL_IDS
        default 8
config SPL_UBI_PEB_OFFSET
        default 3
config SPL_UBI_VID_OFFSET
        default 2048
config SPL_UBI_LEB_START
        default 4096
config SPL_UBI_LOAD_MONITOR_ID
	default 0

config MTDPARTS_DEFAULT
	default "spi-nand0:128K(gcis),128K(spl0),128K(spl1),-@384K(ubi)"

endif
```

## board/apple/oldmac/Kconfig
```kconfig
if TARGET_OLDMAC

config SYS_BOARD
	default "oldmac"

config SYS_VENDOR
	default "apple"

config SYS_CONFIG_NAME
	default "oldmac"

config CMD_NUBUS
	bool "nubus command"
	default y
	help
	  Enable the "nubus" command, which probes the NuBus slots and lists
	  the cards found by reading their declaration ROMs.

endif
```

## board/eltec/e17/Kconfig
```kconfig
if TARGET_E17

config SYS_CPU
	default "mc68000"

config SYS_BOARD
	default "e17"

config SYS_VENDOR
	default "eltec"

config SYS_CONFIG_NAME
	default "e17"

endif
```

## board/kanpapa/mc68ez328sbc/Kconfig
```kconfig
if TARGET_MC68EZ328SBC

config SYS_CPU
	default "mc68000"

config SYS_BOARD
	default "mc68ez328sbc"

config SYS_VENDOR
	default "kanpapa"

config SYS_CONFIG_NAME
	default "mc68ez328sbc"

endif
```

## board/m5stack/unitv2/Kconfig
```kconfig
if TARGET_UNITV2

config SYS_BOARD
	default "unitv2"

config SYS_VENDOR
	default "m5stack"

config SYS_CONFIG_NAME
        default "unitv2"

config MTDPARTS_DEFAULT
	default "spi-nand0:509184K@15104K(UBI)"

config SPL_UBI
	default y
config SPL_UBI_MAX_VOL_LEBS
	default 256
config SPL_UBI_MAX_PEB_SIZE
	default 131072

# Enough for 512MB
config SPL_UBI_MAX_PEBS
	default 4096
config SPL_UBI_VOL_IDS
	default 8
config SPL_UBI_PEB_OFFSET
	default 118
config SPL_UBI_VID_OFFSET
	default 2048
config SPL_UBI_LEB_START
	default 4096
config SPL_UBI_LOAD_MONITOR_ID
	default 0

endif
```

## board/miyoo/miyoomini/Kconfig
```kconfig
if TARGET_MIYOOMINI

config SYS_BOARD
	default "miyoomini"

config SYS_VENDOR
	default "miyoo"

config SYS_CONFIG_NAME
        default "miyoomini"

endif
```

## board/motorola/mvme147/Kconfig
```kconfig
if TARGET_MVME147

config SYS_CPU
	default "mc68000"

config SYS_BOARD
	default "mvme147"

config SYS_VENDOR
	default "motorola"

config SYS_CONFIG_NAME
	default "mvme147"

endif
```

## board/mstar/mstarv7/Kconfig
```kconfig
if TARGET_MSTARV7

config SYS_BOARD
	default "mstarv7"

config SYS_VENDOR
	default "mstar"

config SYS_CONFIG_NAME
        default "mstarv7"

endif
```
